#include "generic-numpad.dtsi"

&kscan0 {
    col-gpios
        = <&gpio0 22 (GPIO_ACTIVE_HIGH | GPIO_PULL_DOWN)>
        , <&gpio0 20 (GPIO_ACTIVE_HIGH | GPIO_PULL_DOWN)>
        , <&gpio0 23 (GPIO_ACTIVE_HIGH | GPIO_PULL_DOWN)>
        , <&gpio0 21 (GPIO_ACTIVE_HIGH | GPIO_PULL_DOWN)>
        ;
};